## main/Kconfig.projbuild
```kconfig
menu "KtinosCare Collar Configuration"

    config COLLAR_PROV_AP_SSID
        string "Provisioning soft-AP SSID (fixed)"
        default "KtinosCollar-Setup"
        help
            SSID broadcast when no credentials in flash or STA connect fails.

    config COLLAR_PROV_AP_PASSWORD
        string "Provisioning soft-AP password (fixed)"
        default "ktinos1234"
        help
            WPA2 password for provisioning AP. Leave empty for open AP.

    config COLLAR_PROV_AP_CHANNEL
        int "Provisioning soft-AP channel"
        range 1 13
        default 6

    config COLLAR_STA_CONNECT_TIMEOUT_SEC
        int "STA initial connect timeout (seconds)"
        range 10 120
        default 30
        help
            Max time to wait for IP after boot before opening provisioning AP.

    config COLLAR_STA_RETRY_MAX
        int "STA disconnect retries before provisioning AP"
        range 1 20
        default 5

    config COLLAR_MQTT_BROKER_URI
        string "MQTT broker URI (mqtts://host:8883)"
        default "mqtts://broker.example.com:8883"

    config COLLAR_DEVICE_UID
        string "Device UID for topic namespace"
        default "collar_dev_001"

    config COLLAR_LTE_APN
        string "LTE APN for PPP dial-up"
        default "internet"

endmenu
```

## sdkconfig.defaults
```kconfig
# KtinosCare collar — default Kconfig (override in menuconfig as needed)
CONFIG_IDF_TARGET="esp32"

# FreeRTOS
CONFIG_FREERTOS_HZ=1000
CONFIG_FREERTOS_USE_TRACE_FACILITY=y

# Wi-Fi
CONFIG_ESP_WIFI_STATIC_RX_BUFFER_NUM=10
CONFIG_ESP_WIFI_DYNAMIC_RX_BUFFER_NUM=32
CONFIG_ESP_WIFI_AMPDU_TX_ENABLED=y
CONFIG_ESP_WIFI_AMPDU_RX_ENABLED=y

# LWIP + PPP (cellular fallback)
CONFIG_LWIP_PPP_SUPPORT=y
CONFIG_LWIP_PPP_PAP_SUPPORT=y
CONFIG_LWIP_PPP_CHAP_SUPPORT=y
CONFIG_LWIP_PPP_MPPE_SUPPORT=y

# NVS / partitions
CONFIG_PARTITION_TABLE_CUSTOM=y
CONFIG_PARTITION_TABLE_CUSTOM_FILENAME="partitions.csv"

# Logging
CONFIG_LOG_DEFAULT_LEVEL_INFO=y
CONFIG_LOG_MAXIMUM_LEVEL_VERBOSE=y

# TLS / MQTT stack headroom
CONFIG_MBEDTLS_CERTIFICATE_BUNDLE=y
CONFIG_ESP_MAIN_TASK_STACK_SIZE=8192
```
